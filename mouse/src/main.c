/*---------------------------------------------------------------------*/
/* --- STC MCU Limited ------------------------------------------------*/
/* --- STC 1T Series MCU Demo Programme -------------------------------*/
/* --- Mobile: (86)13922805190 ----------------------------------------*/
/* --- Fax: 86-0513-55012956,55012947,55012969 ------------------------*/
/* --- Tel: 86-0513-55012928,55012929,55012966 ------------------------*/
/* --- Web: www.STCMCU.com --------------------------------------------*/
/* --- Web: www.STCMCUDATA.com  ---------------------------------------*/
/* --- QQ:  800003751 -------------------------------------------------*/
/* 如果要在程序中使用此代码,请在程序中注明使用了STC的资料及程序        */
/*---------------------------------------------------------------------*/

/*************  功能说明    **************

本例程基于STC8H8K64U为主控芯片的实验箱9进行编写测试.

基于HID协议的USB鼠标范例

将代码下载到试验箱后即可实现USB鼠标的基本功能
矩阵按键中的KEY0为鼠标左键，KEY1为鼠标中键，KEY2为鼠标右键
矩阵按键中的KEY4为左移，KEY5为右移，KEY6为上移，KEY7为下移

下载时, 设置IRC工作频率为 24MHz.

******************************************/

#include "stc.h"
#include "usb.h"
#include "usb_req_class.h"
#include "timer.h"

void sys_init();

void main()
{
    sys_init();
    usb_init();
    timer_init();
    
    EA = 1;
    
    while (1)
    {
        usb_class_in();
        
        if (f1ms)
        {
            f1ms = 0;
            scan_key();
        }
    }
}

void sys_init()
{
	P_SW2 |= 0x80;  //扩展寄存器(XFR)访问使能

    P3M0 &= ~0x03;
    P3M1 |= 0x03;
    
    IRC48MCR = 0x80;
    while (!(IRC48MCR & 0x01));
    
    USBCLK = 0x00;
    USBCON = 0x90;
}
